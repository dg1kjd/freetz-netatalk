## Config.in
```kconfig
config FREETZ_PACKAGE_NETATALK
	bool "Netatalk 2.1.4"
	select FREETZ_LIB_libdb
	select FREETZ_LIB_libcrypto
	select FREETZ_LIB_libssl
	default n
	help
		Netatalk is a kernel level implementation of the AppleTalk 
		Protocol Suite which contains the AppleShare file server (AFP).
```
